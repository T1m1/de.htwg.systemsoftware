## v3/buildroot-packet/Config.in
```kconfig
config BR2_PACHAGE_MYPROG
	bool "Meine Programme"
	select BR2_PACKAGE_FIRSTPROG
	depends on BR2_PACKAGE_NEU_ANGEZEIGT
	help
	  Das ist unser Hilfetext
```

## v4/modul-package/Config.in
```kconfig
config BR2_PACKAGE_SYSO
        bool "syso"
        help
          All Syso Packages

          https://burns.in.htwg-konstanz.de/labworks-SYSO_WS1415/syso_ws1415_14


if BR2_PACKAGE_SYSO
        menu "Modules"
                source package/syso/template/Config.in
                source package/syso/openclose/Config.in
                source package/syso/zero/Config.in
                source package/syso/mynull/Config.in
        endmenu
endif
```

## v5/modul-package/Config.in
```kconfig
config BR2_PACKAGE_SYSO
        bool "syso"
        help
          All Syso Packages

          https://burns.in.htwg-konstanz.de/labworks-SYSO_WS1415/syso_ws1415_14

if BR2_PACKAGE_SYSO
        menu "Modules"
				source package/syso/access/Config.in
				source package/syso/buf/Config.in
				source package/syso/kthread/Config.in
				source package/syso/lock/Config.in
				source package/syso/myzero/Config.in
				source package/syso/open_once/Config.in
                source package/syso/tasklet/Config.in
                source package/syso/timer/Config.in
                source package/syso/wq/Config.in
        endmenu
endif
```

## v6/modul-package/Config.in
```kconfig
config BR2_PACKAGE_SYSO
        bool "syso"
        help
          All Syso Packages

          https://burns.in.htwg-konstanz.de/labworks-SYSO_WS1415/syso_ws1415_14

if BR2_PACKAGE_SYSO
        menu "Modules"
				source package/syso/mygpio/Config.in
				source package/syso/led250/Config.in
				source package/syso/ledflip/Config.in
				source package/syso/ledmax/Config.in
				source package/syso/website/Config.in
        endmenu
endif
```
